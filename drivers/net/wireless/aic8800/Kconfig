## drivers/net/wireless/aic8800/Kconfig
```kconfig
config AIC_WLAN_SUPPORT
	tristate "AIC wireless Support"
	select WIRELESS_EXT
	select WEXT_PRIV
	select CFG80211
	select MAC80211
	select NL80211_TESTMODE
	help
	  This is support for aic wireless chip.

config AIC_FW_PATH
	depends on AIC_WLAN_SUPPORT
	string "Firmware & config file path"
	default "/usr/lib/kernel-overlays/base/lib/firmware"
	#default "/lib/firmware/aic8800_sdio"
	help
	  Path to the firmware & config file.

if AIC_WLAN_SUPPORT
source "drivers/net/wireless/aic8800/aic8800_fdrv/Kconfig"
source "drivers/net/wireless/aic8800/aic8800_btlpm/Kconfig"
endif
```
